MEMORY {
	FLASH (rx)	: ORIGIN = 0x08000000, LENGTH = 0x40000		/* 256K */
	RAM (rwx)	: ORIGIN = 0x20000000, LENGTH = 0xC000		/* 48K  */
	SRAM2 (rwx)	: ORIGIN = 0x10000000, LENGTH = 0x4000		/* 16K  */
}
